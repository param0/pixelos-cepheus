			timing@1 {
				qcom,mdss-dsi-panel-width = <0x438>;
				qcom,mdss-dsi-panel-height = <0x924>;
				qcom,mdss-dsi-h-front-porch = <0x20>;
				qcom,mdss-dsi-h-back-porch = <0x10>;
				qcom,mdss-dsi-h-pulse-width = <0x14>;
				qcom,mdss-dsi-h-sync-skew = <0x00>;
				qcom,mdss-dsi-v-back-porch = <0x10>;
				qcom,mdss-dsi-v-front-porch = <0x10>;
				qcom,mdss-dsi-v-pulse-width = <0x14>;
				qcom,mdss-dsi-h-left-border = <0x00>;
				qcom,mdss-dsi-h-right-border = <0x00>;
				qcom,mdss-dsi-v-top-border = <0x00>;
				qcom,mdss-dsi-v-bottom-border = <0x00>;
				qcom,mdss-dsi-panel-framerate = <0x48>;
				qcom,mdss-dsi-panel-clockrate = <0x4ead9a00>;
				qcom,mdss-dsi-panel-jitter = <0x08 0x0a>;
				qcom,mdss-dsi-on-command = [39 00 00 00 00 00 03 f0 5a 5a 39 00 00 00 00 00 03 fc 5a 5a 39 00 00 00 00 00 02 b0 0c 39 00 00 00 00 00 02 ff 10 39 00 00 00 00 00 02 b0 2f 39 00 00 00 00 00 02 d1 01 39 00 00 00 00 00 03 f0 a5 a5 39 01 00 00 01 00 03 fc a5 a5 05 01 00 00 0a 00 02 11 00 39 00 00 00 00 00 03 f0 5a 5a 39 00 00 00 00 00 02 35 00 39 00 00 00 00 00 03 b7 01 4b 39 01 00 00 00 00 03 f0 a5 a5 39 01 00 00 00 00 05 2b 00 00 09 23 39 00 00 00 00 00 03 f0 5a 5a 39 00 00 00 00 00 03 fc 5a 5a 39 00 00 00 00 00 03 fc 5a 5a 39 00 00 00 00 00 02 b0 23 39 00 00 00 00 00 02 d1 0f 39 00 00 00 00 00 0c e9 11 55 a6 75 a3 b9 a1 4a 00 1a b8 39 00 00 00 00 00 07 e1 00 00 02 02 42 02 39 00 00 00 00 00 07 e2 00 00 00 00 00 00 39 00 00 00 00 00 02 b0 0c 39 00 00 00 00 00 02 e1 19 39 00 00 00 00 00 03 f0 a5 a5 39 01 00 00 00 00 03 fc a5 a5 39 00 00 00 00 00 02 53 20 39 00 00 00 00 00 03 51 00 00 39 01 00 00 43 00 02 55 00 05 01 00 00 00 00 02 29 00];
				qcom,mdss-dsi-timing-switch-command = [39 00 00 00 00 00 03 f0 5a 5a 39 00 00 00 00 00 03 fc 5a 5a 39 00 00 00 00 00 02 b0 23 39 00 00 00 00 00 02 d1 0f 39 00 00 00 00 00 0c e9 11 55 a6 75 a3 b9 a1 4a 00 8a 18 39 00 00 00 00 00 03 f0 a5 a5 39 01 00 00 00 00 03 fc a5 a5];
				qcom,mdss-dsi-timing-switch-command-state = "dsi_lp_mode";
				qcom,mdss-dsi-off-command = [05 01 00 00 00 00 02 28 00 05 01 00 00 78 00 02 10 00];
				qcom,mdss-dsi-on-command-state = "dsi_lp_mode";
				qcom,mdss-dsi-off-command-state = "dsi_lp_mode";
				qcom,mdss-dsi-doze-hbm-command = [39 00 00 00 00 00 03 f0 5a 5a 39 00 00 00 00 00 02 d4 8b 39 00 00 00 00 00 02 b0 a5 39 00 00 00 00 00 02 c7 00 39 00 00 00 00 00 02 b0 69 39 00 00 00 00 00 03 b9 08 8f 39 00 00 00 00 00 02 53 22 39 01 00 00 00 00 03 f0 a5 a5];
				qcom,mdss-dsi-doze-lbm-command = [39 00 00 00 00 00 03 f0 5a 5a 39 00 00 00 00 00 02 d4 8b 39 00 00 00 00 00 02 b0 a5 39 00 00 00 00 00 02 c7 00 39 00 00 00 00 00 02 b0 69 39 00 00 00 00 00 03 b9 08 8f 39 00 00 00 00 00 02 53 23 39 01 00 00 00 00 03 f0 a5 a5];
				qcom,mdss-dsi-nolp-command = [05 01 00 00 10 00 02 28 00 39 01 00 00 00 00 02 53 20 05 01 00 00 00 00 02 29 00];
				qcom,mdss-dsi-doze-hbm-command-state = "dsi_lp_mode";
				qcom,mdss-dsi-doze-lbm-command-state = "dsi_lp_mode";
				qcom,mdss-dsi-nolp-command-state = "dsi_lp_mode";
				qcom,mdss-dsi-dispparam-acl-off-command = [39 01 00 00 00 00 02 55 00];
				qcom,mdss-dsi-dispparam-acl-off-command-state = "dsi_lp_mode";
				qcom,mdss-dsi-dispparam-acl-l1-command = [39 01 00 00 00 00 02 55 01];
				qcom,mdss-dsi-dispparam-acl-l1-command-state = "dsi_lp_mode";
				qcom,mdss-dsi-dispparam-acl-l2-command = [39 01 00 00 00 00 02 55 02];
				qcom,mdss-dsi-dispparam-acl-l2-command-state = "dsi_lp_mode";
				qcom,mdss-dsi-dispparam-acl-l3-command = [39 01 00 00 00 00 02 55 03];
				qcom,mdss-dsi-dispparam-acl-l3-command-state = "dsi_lp_mode";
				qcom,mdss-dsi-dispparam-hbm-off-command = [39 01 00 00 00 00 02 53 28];
				qcom,mdss-dsi-dispparam-hbm-off-command-state = "dsi_lp_mode";
				qcom,mdss-dsi-dispparam-hbm-on-command = [39 01 00 00 00 00 02 53 e8];
				qcom,mdss-dsi-dispparam-hbm-on-command-state = "dsi_lp_mode";
				qcom,mdss-dsi-dispparam-hbm-fod-off-command = [39 01 00 00 00 00 02 53 20 39 00 00 00 00 00 03 f0 5a 5a 39 00 00 00 00 00 03 b7 01 4b 39 00 00 00 00 00 02 b0 03 39 00 00 00 00 00 02 b7 49 39 00 00 00 00 00 02 b0 07 39 00 00 00 00 00 02 b7 91 39 01 00 00 01 00 03 f0 a5 a5];
				qcom,mdss-dsi-dispparam-hbm-fod-off-command-state = "dsi_hs_mode";
				qcom,mdss-dsi-dispparam-hbm-fod-on-command = [39 00 00 00 00 00 03 f0 5a 5a 39 00 00 00 00 00 02 b0 03 39 00 00 00 00 00 02 b7 c9 39 00 00 00 00 00 02 b0 07 39 00 00 00 00 00 02 b7 91 39 00 00 00 00 00 03 f0 a5 a5 39 01 00 00 01 00 02 53 e0 39 00 00 00 00 00 03 f0 5a 5a 39 00 00 00 00 00 03 b7 01 43 39 01 00 00 01 00 03 f0 a5 a5];
				qcom,mdss-dsi-dispparam-hbm-fod-on-command-state = "dsi_hs_mode";
				qcom,mdss-dsi-dispparam-hbm-fod2norm-command = [39 00 00 00 00 00 03 f0 5a 5a 39 00 00 00 00 00 03 b2 00 40 39 00 00 00 00 00 02 b0 04 39 00 00 00 00 00 02 b2 80 39 00 00 00 00 00 02 f7 03 39 01 00 00 00 00 03 f0 a5 a5];
				qcom,mdss-dsi-dispparam-hbm-fod2norm-command-state = "dsi_hs_mode";
				qcom,mdss-dsi-dispparam-hbm-fod-off-doze-hbm-on-command = [39 01 00 00 00 00 02 53 22 39 00 00 00 00 00 03 f0 5a 5a 39 00 00 00 00 00 03 b7 01 4b 39 00 00 00 00 00 02 b0 03 39 00 00 00 00 00 02 b7 49 39 00 00 00 00 00 02 b0 07 39 00 00 00 00 00 02 b7 91 39 01 00 00 01 00 03 f0 a5 a5];
				qcom,mdss-dsi-dispparam-hbm-fod-off-doze-hbm-on-command-state = "dsi_hs_mode";
				qcom,mdss-dsi-dispparam-hbm-fod-off-doze-lbm-on-command = [39 01 00 00 00 00 02 53 23 39 00 00 00 00 00 03 f0 5a 5a 39 00 00 00 00 00 03 b7 01 4b 39 00 00 00 00 00 02 b0 03 39 00 00 00 00 00 02 b7 49 39 00 00 00 00 00 02 b0 07 39 00 00 00 00 00 02 b7 91 39 01 00 00 01 00 03 f0 a5 a5];
				qcom,mdss-dsi-dispparam-hbm-fod-off-doze-lbm-on-command-state = "dsi_hs_mode";
				qcom,mdss-dsi-dispparam-dimmingon-command = [39 01 00 00 01 00 02 53 28];
				qcom,mdss-dsi-dispparam-dimmingon-command-state = "dsi_lp_mode";
				qcom,mdss-dsi-dispparam-dimmingoff-command = [39 01 00 00 01 00 02 53 20];
				qcom,mdss-dsi-dispparam-dimmingoff-command-state = "dsi_lp_mode";
				qcom,mdss-dsi-dispparam-crc-srgb-on-command = [39 01 00 00 00 00 02 81 90 39 01 00 00 00 00 03 f0 5a 5a 39 01 00 00 00 00 02 b1 00 39 01 00 00 00 00 02 b0 01 39 01 00 00 00 00 16 b1 ae 0c 05 3f c6 14 05 07 aa 4a dd c8 c3 14 c0 e8 dc 19 ff f4 d9 39 01 00 00 00 00 02 b0 16 39 01 00 00 00 00 16 b1 bd 02 00 14 d1 00 04 07 aa 0c ec cb c8 0f dd d9 e4 05 ff ff ff 39 01 00 00 00 00 03 f0 a5 a5];
				qcom,mdss-dsi-dispparam-crc-srgb-on-command-state = "dsi_lp_mode";
				qcom,mdss-dsi-dispparam-crc-dcip3-on-command = [39 01 00 00 00 00 02 81 91 39 01 00 00 00 00 03 f0 5a 5a 39 01 00 00 00 00 02 b1 00 39 01 00 00 00 00 02 b0 01 39 01 00 00 00 00 16 b1 ae 0c 05 3f c6 14 05 07 aa 4a dd c8 c3 14 c0 e8 dc 19 ff f4 d9 39 01 00 00 00 00 02 b0 16 39 01 00 00 00 00 16 b1 d2 0a 05 1a e6 00 04 07 f5 0c dc db e8 0f dd ee e9 05 ff ff ff 39 01 00 00 00 00 03 f0 a5 a5];
				qcom,mdss-dsi-dispparam-crc-dcip3-on-command-state = "dsi_lp_mode";
				qcom,mdss-dsi-dispparam-crc-off-command = [39 01 00 00 00 00 02 81 00 39 01 00 00 00 00 03 f0 5a 5a 39 01 00 00 00 00 02 b1 01 39 01 00 00 00 00 03 f0 a5 a5];
				qcom,mdss-dsi-dispparam-crc-off-command-state = "dsi_lp_mode";
				qcom,mdss-dsi-dispparam-elvss-dimming-off-command = [39 00 00 00 00 00 03 f0 5a 5a 39 00 00 00 00 00 02 b0 07 39 00 00 00 00 00 02 b7 91 39 01 00 00 01 00 03 f0 a5 a5];
				qcom,mdss-dsi-dispparam-elvss-dimming-off-command-state = "dsi_lp_mode";
				qcom,mdss-dsi-h-sync-pulse = <0x00>;
				mi,mdss-dsi-dispparam-xy-coordinate-command = [15 01 00 00 00 00 02 ff 10 06 01 00 00 00 00 01 a1];
				mi,mdss-dsi-dispparam-xy-coordinate-command-state = "dsi_lp_mode";
				mi,mdss-dsi-max-luminance-write-command = [15 01 00 00 00 00 02 ff 10];
				mi,mdss-dsi-max-luminance-write-command-state = "dsi_lp_mode";
				mi,mdss-dsi-max-luminance-read-command = <0x6010000 0x1a1>;
				mi,mdss-dsi-max-luminance-read-command-state = "dsi_lp_mode";
				qcom,display-topology = <0x01 0x00 0x01>;
				qcom,default-topology-index = <0x00>;
			};

			timing@2 {
				qcom,mdss-dsi-panel-width = <0x438>;
				qcom,mdss-dsi-panel-height = <0x924>;
				qcom,mdss-dsi-h-front-porch = <0x20>;
				qcom,mdss-dsi-h-back-porch = <0x10>;
				qcom,mdss-dsi-h-pulse-width = <0x14>;
				qcom,mdss-dsi-h-sync-skew = <0x00>;
				qcom,mdss-dsi-v-back-porch = <0x10>;
				qcom,mdss-dsi-v-front-porch = <0x10>;
				qcom,mdss-dsi-v-pulse-width = <0x14>;
				qcom,mdss-dsi-h-left-border = <0x00>;
				qcom,mdss-dsi-h-right-border = <0x00>;
				qcom,mdss-dsi-v-top-border = <0x00>;
				qcom,mdss-dsi-v-bottom-border = <0x00>;
				qcom,mdss-dsi-panel-framerate = <0x51>;
				qcom,mdss-dsi-panel-clockrate = <0x58834d40>;
				qcom,mdss-dsi-panel-jitter = <0x08 0x0a>;
				qcom,mdss-dsi-on-command = [39 00 00 00 00 00 03 f0 5a 5a 39 00 00 00 00 00 03 fc 5a 5a 39 00 00 00 00 00 02 b0 0c 39 00 00 00 00 00 02 ff 10 39 00 00 00 00 00 02 b0 2f 39 00 00 00 00 00 02 d1 01 39 00 00 00 00 00 03 f0 a5 a5 39 01 00 00 01 00 03 fc a5 a5 05 01 00 00 0a 00 02 11 00 39 00 00 00 00 00 03 f0 5a 5a 39 00 00 00 00 00 02 35 00 39 00 00 00 00 00 03 b7 01 4b 39 01 00 00 00 00 03 f0 a5 a5 39 01 00 00 00 00 05 2b 00 00 09 23 39 00 00 00 00 00 03 f0 5a 5a 39 00 00 00 00 00 03 fc 5a 5a 39 00 00 00 00 00 03 fc 5a 5a 39 00 00 00 00 00 02 b0 23 39 00 00 00 00 00 02 d1 0f 39 00 00 00 00 00 0c e9 11 55 a6 75 a3 b9 a1 4a 00 1a b8 39 00 00 00 00 00 07 e1 00 00 02 02 42 02 39 00 00 00 00 00 07 e2 00 00 00 00 00 00 39 00 00 00 00 00 02 b0 0c 39 00 00 00 00 00 02 e1 19 39 00 00 00 00 00 03 f0 a5 a5 39 01 00 00 00 00 03 fc a5 a5 39 00 00 00 00 00 02 53 20 39 00 00 00 00 00 03 51 00 00 39 01 00 00 43 00 02 55 00 05 01 00 00 00 00 02 29 00];
				qcom,mdss-dsi-timing-switch-command = [39 00 00 00 00 00 03 f0 5a 5a 39 00 00 00 00 00 03 fc 5a 5a 39 00 00 00 00 00 02 b0 23 39 00 00 00 00 00 02 d1 0f 39 00 00 00 00 00 0c e9 11 55 a6 75 a3 b9 a1 4a 00 8a 18 39 00 00 00 00 00 03 f0 a5 a5 39 01 00 00 00 00 03 fc a5 a5];
				qcom,mdss-dsi-timing-switch-command-state = "dsi_lp_mode";
				qcom,mdss-dsi-off-command = [05 01 00 00 00 00 02 28 00 05 01 00 00 78 00 02 10 00];
				qcom,mdss-dsi-on-command-state = "dsi_lp_mode";
				qcom,mdss-dsi-off-command-state = "dsi_lp_mode";
				qcom,mdss-dsi-doze-hbm-command = [39 00 00 00 00 00 03 f0 5a 5a 39 00 00 00 00 00 02 d4 8b 39 00 00 00 00 00 02 b0 a5 39 00 00 00 00 00 02 c7 00 39 00 00 00 00 00 02 b0 69 39 00 00 00 00 00 03 b9 08 8f 39 00 00 00 00 00 02 53 22 39 01 00 00 00 00 03 f0 a5 a5];
				qcom,mdss-dsi-doze-lbm-command = [39 00 00 00 00 00 03 f0 5a 5a 39 00 00 00 00 00 02 d4 8b 39 00 00 00 00 00 02 b0 a5 39 00 00 00 00 00 02 c7 00 39 00 00 00 00 00 02 b0 69 39 00 00 00 00 00 03 b9 08 8f 39 00 00 00 00 00 02 53 23 39 01 00 00 00 00 03 f0 a5 a5];
				qcom,mdss-dsi-nolp-command = [05 01 00 00 10 00 02 28 00 39 01 00 00 00 00 02 53 20 05 01 00 00 00 00 02 29 00];
				qcom,mdss-dsi-doze-hbm-command-state = "dsi_lp_mode";
				qcom,mdss-dsi-doze-lbm-command-state = "dsi_lp_mode";
				qcom,mdss-dsi-nolp-command-state = "dsi_lp_mode";
				qcom,mdss-dsi-dispparam-acl-off-command = [39 01 00 00 00 00 02 55 00];
				qcom,mdss-dsi-dispparam-acl-off-command-state = "dsi_lp_mode";
				qcom,mdss-dsi-dispparam-acl-l1-command = [39 01 00 00 00 00 02 55 01];
				qcom,mdss-dsi-dispparam-acl-l1-command-state = "dsi_lp_mode";
				qcom,mdss-dsi-dispparam-acl-l2-command = [39 01 00 00 00 00 02 55 02];
				qcom,mdss-dsi-dispparam-acl-l2-command-state = "dsi_lp_mode";
				qcom,mdss-dsi-dispparam-acl-l3-command = [39 01 00 00 00 00 02 55 03];
				qcom,mdss-dsi-dispparam-acl-l3-command-state = "dsi_lp_mode";
				qcom,mdss-dsi-dispparam-hbm-off-command = [39 01 00 00 00 00 02 53 28];
				qcom,mdss-dsi-dispparam-hbm-off-command-state = "dsi_lp_mode";
				qcom,mdss-dsi-dispparam-hbm-on-command = [39 01 00 00 00 00 02 53 e8];
				qcom,mdss-dsi-dispparam-hbm-on-command-state = "dsi_lp_mode";
				qcom,mdss-dsi-dispparam-hbm-fod-off-command = [39 01 00 00 00 00 02 53 20 39 00 00 00 00 00 03 f0 5a 5a 39 00 00 00 00 00 03 b7 01 4b 39 00 00 00 00 00 02 b0 03 39 00 00 00 00 00 02 b7 49 39 00 00 00 00 00 02 b0 07 39 00 00 00 00 00 02 b7 91 39 01 00 00 01 00 03 f0 a5 a5];
				qcom,mdss-dsi-dispparam-hbm-fod-off-command-state = "dsi_hs_mode";
				qcom,mdss-dsi-dispparam-hbm-fod-on-command = [39 00 00 00 00 00 03 f0 5a 5a 39 00 00 00 00 00 02 b0 03 39 00 00 00 00 00 02 b7 c9 39 00 00 00 00 00 02 b0 07 39 00 00 00 00 00 02 b7 91 39 00 00 00 00 00 03 f0 a5 a5 39 01 00 00 01 00 02 53 e0 39 00 00 00 00 00 03 f0 5a 5a 39 00 00 00 00 00 03 b7 01 43 39 01 00 00 01 00 03 f0 a5 a5];
				qcom,mdss-dsi-dispparam-hbm-fod-on-command-state = "dsi_hs_mode";
				qcom,mdss-dsi-dispparam-hbm-fod2norm-command = [39 00 00 00 00 00 03 f0 5a 5a 39 00 00 00 00 00 03 b2 00 40 39 00 00 00 00 00 02 b0 04 39 00 00 00 00 00 02 b2 80 39 00 00 00 00 00 02 f7 03 39 01 00 00 00 00 03 f0 a5 a5];
				qcom,mdss-dsi-dispparam-hbm-fod2norm-command-state = "dsi_hs_mode";
				qcom,mdss-dsi-dispparam-hbm-fod-off-doze-hbm-on-command = [39 01 00 00 00 00 02 53 22 39 00 00 00 00 00 03 f0 5a 5a 39 00 00 00 00 00 03 b7 01 4b 39 00 00 00 00 00 02 b0 03 39 00 00 00 00 00 02 b7 49 39 00 00 00 00 00 02 b0 07 39 00 00 00 00 00 02 b7 91 39 01 00 00 01 00 03 f0 a5 a5];
				qcom,mdss-dsi-dispparam-hbm-fod-off-doze-hbm-on-command-state = "dsi_hs_mode";
				qcom,mdss-dsi-dispparam-hbm-fod-off-doze-lbm-on-command = [39 01 00 00 00 00 02 53 23 39 00 00 00 00 00 03 f0 5a 5a 39 00 00 00 00 00 03 b7 01 4b 39 00 00 00 00 00 02 b0 03 39 00 00 00 00 00 02 b7 49 39 00 00 00 00 00 02 b0 07 39 00 00 00 00 00 02 b7 91 39 01 00 00 01 00 03 f0 a5 a5];
				qcom,mdss-dsi-dispparam-hbm-fod-off-doze-lbm-on-command-state = "dsi_hs_mode";
				qcom,mdss-dsi-dispparam-dimmingon-command = [39 01 00 00 01 00 02 53 28];
				qcom,mdss-dsi-dispparam-dimmingon-command-state = "dsi_lp_mode";
				qcom,mdss-dsi-dispparam-dimmingoff-command = [39 01 00 00 01 00 02 53 20];
				qcom,mdss-dsi-dispparam-dimmingoff-command-state = "dsi_lp_mode";
				qcom,mdss-dsi-dispparam-crc-srgb-on-command = [39 01 00 00 00 00 02 81 90 39 01 00 00 00 00 03 f0 5a 5a 39 01 00 00 00 00 02 b1 00 39 01 00 00 00 00 02 b0 01 39 01 00 00 00 00 16 b1 ae 0c 05 3f c6 14 05 07 aa 4a dd c8 c3 14 c0 e8 dc 19 ff f4 d9 39 01 00 00 00 00 02 b0 16 39 01 00 00 00 00 16 b1 bd 02 00 14 d1 00 04 07 aa 0c ec cb c8 0f dd d9 e4 05 ff ff ff 39 01 00 00 00 00 03 f0 a5 a5];
				qcom,mdss-dsi-dispparam-crc-srgb-on-command-state = "dsi_lp_mode";
				qcom,mdss-dsi-dispparam-crc-dcip3-on-command = [39 01 00 00 00 00 02 81 91 39 01 00 00 00 00 03 f0 5a 5a 39 01 00 00 00 00 02 b1 00 39 01 00 00 00 00 02 b0 01 39 01 00 00 00 00 16 b1 ae 0c 05 3f c6 14 05 07 aa 4a dd c8 c3 14 c0 e8 dc 19 ff f4 d9 39 01 00 00 00 00 02 b0 16 39 01 00 00 00 00 16 b1 d2 0a 05 1a e6 00 04 07 f5 0c dc db e8 0f dd ee e9 05 ff ff ff 39 01 00 00 00 00 03 f0 a5 a5];
				qcom,mdss-dsi-dispparam-crc-dcip3-on-command-state = "dsi_lp_mode";
				qcom,mdss-dsi-dispparam-crc-off-command = [39 01 00 00 00 00 02 81 00 39 01 00 00 00 00 03 f0 5a 5a 39 01 00 00 00 00 02 b1 01 39 01 00 00 00 00 03 f0 a5 a5];
				qcom,mdss-dsi-dispparam-crc-off-command-state = "dsi_lp_mode";
				qcom,mdss-dsi-dispparam-elvss-dimming-off-command = [39 00 00 00 00 00 03 f0 5a 5a 39 00 00 00 00 00 02 b0 07 39 00 00 00 00 00 02 b7 91 39 01 00 00 01 00 03 f0 a5 a5];
				qcom,mdss-dsi-dispparam-elvss-dimming-off-command-state = "dsi_lp_mode";
				qcom,mdss-dsi-h-sync-pulse = <0x00>;
				mi,mdss-dsi-dispparam-xy-coordinate-command = [15 01 00 00 00 00 02 ff 10 06 01 00 00 00 00 01 a1];
				mi,mdss-dsi-dispparam-xy-coordinate-command-state = "dsi_lp_mode";
				mi,mdss-dsi-max-luminance-write-command = [15 01 00 00 00 00 02 ff 10];
				mi,mdss-dsi-max-luminance-write-command-state = "dsi_lp_mode";
				mi,mdss-dsi-max-luminance-read-command = <0x6010000 0x1a1>;
				mi,mdss-dsi-max-luminance-read-command-state = "dsi_lp_mode";
				qcom,display-topology = <0x01 0x00 0x01>;
				qcom,default-topology-index = <0x00>;
			};

			timing@3 {
				qcom,mdss-dsi-panel-width = <0x438>;
				qcom,mdss-dsi-panel-height = <0x924>;
				qcom,mdss-dsi-h-front-porch = <0x20>;
				qcom,mdss-dsi-h-back-porch = <0x10>;
				qcom,mdss-dsi-h-pulse-width = <0x14>;
				qcom,mdss-dsi-h-sync-skew = <0x00>;
				qcom,mdss-dsi-v-back-porch = <0x10>;
				qcom,mdss-dsi-v-front-porch = <0x10>;
				qcom,mdss-dsi-v-pulse-width = <0x14>;
				qcom,mdss-dsi-h-left-border = <0x00>;
				qcom,mdss-dsi-h-right-border = <0x00>;
				qcom,mdss-dsi-v-top-border = <0x00>;
				qcom,mdss-dsi-v-bottom-border = <0x00>;
				qcom,mdss-dsi-panel-framerate = <0x5a>;
				qcom,mdss-dsi-panel-clockrate = <0x62590080>;
				qcom,mdss-dsi-panel-jitter = <0x08 0x0a>;
				qcom,mdss-dsi-on-command = [39 00 00 00 00 00 03 f0 5a 5a 39 00 00 00 00 00 03 fc 5a 5a 39 00 00 00 00 00 02 b0 0c 39 00 00 00 00 00 02 ff 10 39 00 00 00 00 00 02 b0 2f 39 00 00 00 00 00 02 d1 01 39 00 00 00 00 00 03 f0 a5 a5 39 01 00 00 01 00 03 fc a5 a5 05 01 00 00 0a 00 02 11 00 39 00 00 00 00 00 03 f0 5a 5a 39 00 00 00 00 00 02 35 00 39 00 00 00 00 00 03 b7 01 4b 39 01 00 00 00 00 03 f0 a5 a5 39 01 00 00 00 00 05 2b 00 00 09 23 39 00 00 00 00 00 03 f0 5a 5a 39 00 00 00 00 00 03 fc 5a 5a 39 00 00 00 00 00 03 fc 5a 5a 39 00 00 00 00 00 02 b0 23 39 00 00 00 00 00 02 d1 0f 39 00 00 00 00 00 0c e9 11 55 a6 75 a3 b9 a1 4a 00 1a b8 39 00 00 00 00 00 07 e1 00 00 02 02 42 02 39 00 00 00 00 00 07 e2 00 00 00 00 00 00 39 00 00 00 00 00 02 b0 0c 39 00 00 00 00 00 02 e1 19 39 00 00 00 00 00 03 f0 a5 a5 39 01 00 00 00 00 03 fc a5 a5 39 00 00 00 00 00 02 53 20 39 00 00 00 00 00 03 51 00 00 39 01 00 00 43 00 02 55 00 05 01 00 00 00 00 02 29 00];
				qcom,mdss-dsi-timing-switch-command = [39 00 00 00 00 00 03 f0 5a 5a 39 00 00 00 00 00 03 fc 5a 5a 39 00 00 00 00 00 02 b0 23 39 00 00 00 00 00 02 d1 0f 39 00 00 00 00 00 0c e9 11 55 a6 75 a3 b9 a1 4a 00 8a 18 39 00 00 00 00 00 03 f0 a5 a5 39 01 00 00 00 00 03 fc a5 a5];
				qcom,mdss-dsi-timing-switch-command-state = "dsi_lp_mode";
				qcom,mdss-dsi-off-command = [05 01 00 00 00 00 02 28 00 05 01 00 00 78 00 02 10 00];
				qcom,mdss-dsi-on-command-state = "dsi_lp_mode";
				qcom,mdss-dsi-off-command-state = "dsi_lp_mode";
				qcom,mdss-dsi-doze-hbm-command = [39 00 00 00 00 00 03 f0 5a 5a 39 00 00 00 00 00 02 d4 8b 39 00 00 00 00 00 02 b0 a5 39 00 00 00 00 00 02 c7 00 39 00 00 00 00 00 02 b0 69 39 00 00 00 00 00 03 b9 08 8f 39 00 00 00 00 00 02 53 22 39 01 00 00 00 00 03 f0 a5 a5];
				qcom,mdss-dsi-doze-lbm-command = [39 00 00 00 00 00 03 f0 5a 5a 39 00 00 00 00 00 02 d4 8b 39 00 00 00 00 00 02 b0 a5 39 00 00 00 00 00 02 c7 00 39 00 00 00 00 00 02 b0 69 39 00 00 00 00 00 03 b9 08 8f 39 00 00 00 00 00 02 53 23 39 01 00 00 00 00 03 f0 a5 a5];
				qcom,mdss-dsi-nolp-command = [05 01 00 00 10 00 02 28 00 39 01 00 00 00 00 02 53 20 05 01 00 00 00 00 02 29 00];
				qcom,mdss-dsi-doze-hbm-command-state = "dsi_lp_mode";
				qcom,mdss-dsi-doze-lbm-command-state = "dsi_lp_mode";
				qcom,mdss-dsi-nolp-command-state = "dsi_lp_mode";
				qcom,mdss-dsi-dispparam-acl-off-command = [39 01 00 00 00 00 02 55 00];
				qcom,mdss-dsi-dispparam-acl-off-command-state = "dsi_lp_mode";
				qcom,mdss-dsi-dispparam-acl-l1-command = [39 01 00 00 00 00 02 55 01];
				qcom,mdss-dsi-dispparam-acl-l1-command-state = "dsi_lp_mode";
				qcom,mdss-dsi-dispparam-acl-l2-command = [39 01 00 00 00 00 02 55 02];
				qcom,mdss-dsi-dispparam-acl-l2-command-state = "dsi_lp_mode";
				qcom,mdss-dsi-dispparam-acl-l3-command = [39 01 00 00 00 00 02 55 03];
				qcom,mdss-dsi-dispparam-acl-l3-command-state = "dsi_lp_mode";
				qcom,mdss-dsi-dispparam-hbm-off-command = [39 01 00 00 00 00 02 53 28];
				qcom,mdss-dsi-dispparam-hbm-off-command-state = "dsi_lp_mode";
				qcom,mdss-dsi-dispparam-hbm-on-command = [39 01 00 00 00 00 02 53 e8];
				qcom,mdss-dsi-dispparam-hbm-on-command-state = "dsi_lp_mode";
				qcom,mdss-dsi-dispparam-hbm-fod-off-command = [39 01 00 00 00 00 02 53 20 39 00 00 00 00 00 03 f0 5a 5a 39 00 00 00 00 00 03 b7 01 4b 39 00 00 00 00 00 02 b0 03 39 00 00 00 00 00 02 b7 49 39 00 00 00 00 00 02 b0 07 39 00 00 00 00 00 02 b7 91 39 01 00 00 01 00 03 f0 a5 a5];
				qcom,mdss-dsi-dispparam-hbm-fod-off-command-state = "dsi_hs_mode";
				qcom,mdss-dsi-dispparam-hbm-fod-on-command = [39 00 00 00 00 00 03 f0 5a 5a 39 00 00 00 00 00 02 b0 03 39 00 00 00 00 00 02 b7 c9 39 00 00 00 00 00 02 b0 07 39 00 00 00 00 00 02 b7 91 39 00 00 00 00 00 03 f0 a5 a5 39 01 00 00 01 00 02 53 e0 39 00 00 00 00 00 03 f0 5a 5a 39 00 00 00 00 00 03 b7 01 43 39 01 00 00 01 00 03 f0 a5 a5];
				qcom,mdss-dsi-dispparam-hbm-fod-on-command-state = "dsi_hs_mode";
				qcom,mdss-dsi-dispparam-hbm-fod2norm-command = [39 00 00 00 00 00 03 f0 5a 5a 39 00 00 00 00 00 03 b2 00 40 39 00 00 00 00 00 02 b0 04 39 00 00 00 00 00 02 b2 80 39 00 00 00 00 00 02 f7 03 39 01 00 00 00 00 03 f0 a5 a5];
				qcom,mdss-dsi-dispparam-hbm-fod2norm-command-state = "dsi_hs_mode";
				qcom,mdss-dsi-dispparam-hbm-fod-off-doze-hbm-on-command = [39 01 00 00 00 00 02 53 22 39 00 00 00 00 00 03 f0 5a 5a 39 00 00 00 00 00 03 b7 01 4b 39 00 00 00 00 00 02 b0 03 39 00 00 00 00 00 02 b7 49 39 00 00 00 00 00 02 b0 07 39 00 00 00 00 00 02 b7 91 39 01 00 00 01 00 03 f0 a5 a5];
				qcom,mdss-dsi-dispparam-hbm-fod-off-doze-hbm-on-command-state = "dsi_hs_mode";
				qcom,mdss-dsi-dispparam-hbm-fod-off-doze-lbm-on-command = [39 01 00 00 00 00 02 53 23 39 00 00 00 00 00 03 f0 5a 5a 39 00 00 00 00 00 03 b7 01 4b 39 00 00 00 00 00 02 b0 03 39 00 00 00 00 00 02 b7 49 39 00 00 00 00 00 02 b0 07 39 00 00 00 00 00 02 b7 91 39 01 00 00 01 00 03 f0 a5 a5];
				qcom,mdss-dsi-dispparam-hbm-fod-off-doze-lbm-on-command-state = "dsi_hs_mode";
				qcom,mdss-dsi-dispparam-dimmingon-command = [39 01 00 00 01 00 02 53 28];
				qcom,mdss-dsi-dispparam-dimmingon-command-state = "dsi_lp_mode";
				qcom,mdss-dsi-dispparam-dimmingoff-command = [39 01 00 00 01 00 02 53 20];
				qcom,mdss-dsi-dispparam-dimmingoff-command-state = "dsi_lp_mode";
				qcom,mdss-dsi-dispparam-crc-srgb-on-command = [39 01 00 00 00 00 02 81 90 39 01 00 00 00 00 03 f0 5a 5a 39 01 00 00 00 00 02 b1 00 39 01 00 00 00 00 02 b0 01 39 01 00 00 00 00 16 b1 ae 0c 05 3f c6 14 05 07 aa 4a dd c8 c3 14 c0 e8 dc 19 ff f4 d9 39 01 00 00 00 00 02 b0 16 39 01 00 00 00 00 16 b1 bd 02 00 14 d1 00 04 07 aa 0c ec cb c8 0f dd d9 e4 05 ff ff ff 39 01 00 00 00 00 03 f0 a5 a5];
				qcom,mdss-dsi-dispparam-crc-srgb-on-command-state = "dsi_lp_mode";
				qcom,mdss-dsi-dispparam-crc-dcip3-on-command = [39 01 00 00 00 00 02 81 91 39 01 00 00 00 00 03 f0 5a 5a 39 01 00 00 00 00 02 b1 00 39 01 00 00 00 00 02 b0 01 39 01 00 00 00 00 16 b1 ae 0c 05 3f c6 14 05 07 aa 4a dd c8 c3 14 c0 e8 dc 19 ff f4 d9 39 01 00 00 00 00 02 b0 16 39 01 00 00 00 00 16 b1 d2 0a 05 1a e6 00 04 07 f5 0c dc db e8 0f dd ee e9 05 ff ff ff 39 01 00 00 00 00 03 f0 a5 a5];
				qcom,mdss-dsi-dispparam-crc-dcip3-on-command-state = "dsi_lp_mode";
				qcom,mdss-dsi-dispparam-crc-off-command = [39 01 00 00 00 00 02 81 00 39 01 00 00 00 00 03 f0 5a 5a 39 01 00 00 00 00 02 b1 01 39 01 00 00 00 00 03 f0 a5 a5];
				qcom,mdss-dsi-dispparam-crc-off-command-state = "dsi_lp_mode";
				qcom,mdss-dsi-dispparam-elvss-dimming-off-command = [39 00 00 00 00 00 03 f0 5a 5a 39 00 00 00 00 00 02 b0 07 39 00 00 00 00 00 02 b7 91 39 01 00 00 01 00 03 f0 a5 a5];
				qcom,mdss-dsi-dispparam-elvss-dimming-off-command-state = "dsi_lp_mode";
				qcom,mdss-dsi-h-sync-pulse = <0x00>;
				mi,mdss-dsi-dispparam-xy-coordinate-command = [15 01 00 00 00 00 02 ff 10 06 01 00 00 00 00 01 a1];
				mi,mdss-dsi-dispparam-xy-coordinate-command-state = "dsi_lp_mode";
				mi,mdss-dsi-max-luminance-write-command = [15 01 00 00 00 00 02 ff 10];
				mi,mdss-dsi-max-luminance-write-command-state = "dsi_lp_mode";
				mi,mdss-dsi-max-luminance-read-command = <0x6010000 0x1a1>;
				mi,mdss-dsi-max-luminance-read-command-state = "dsi_lp_mode";
				qcom,display-topology = <0x01 0x00 0x01>;
				qcom,default-topology-index = <0x00>;
			};
